## conf/distro/redrouter.conf
```bitbake
DISTRO = "redrouter"
DISTRO_NAME = "Bouter (Bobs Router)"
DISTRO_VERSION = "0.0.0"
DISTRO_CODENAME = "redrouter-dunfell"
SDK_VENDOR = "-redroutersdk"
SDK_VERSION = "${@d.getVar('DISTRO_VERSION').replace('snapshot-${DATE}', 'snapshot')}"

MAINTAINER = "Robert Joslyn <robert.joslyn@redrectangle.org>"

TARGET_VENDOR = "-redrouter"

LOCALCONF_VERSION = "1"

DISTRO_VERSION[vardepsexclude] = "DATE"
SDK_VERSION[vardepsexclude] = "DATE"

#DISTRO_FEATURES_DEFAULT = "acl alsa argp bluetooth ext2 ipv4 ipv6 largefile pcmcia usbgadget usbhost wifi xattr nfs zeroconf pci 3g nfc x11 vfat"
# Override these in redrouter based distros
#REDROUTER_DEFAULT_DISTRO_FEATURES = "largefile opengl ptest multiarch wayland vulkan"
REDROUTER_DEFAULT_DISTRO_FEATURES = " \
    argp \
    ipv4 \
    ipv6 \
    largefile \
    pci \
    vfat \
"
REDROUTER_DEFAULT_EXTRA_RDEPENDS = "packagegroup-core-boot"
REDROUTER_DEFAULT_EXTRA_RRECOMMENDS = "kernel-module-af-packet"

DISTRO_FEATURES ?= "${REDROUTER_DEFAULT_DISTRO_FEATURES}"

INIT_MANAGER = "systemd"

#PREFERRED_VERSION_linux-yocto ?= "5.4%"
PREFERRED_PROVIDER_virtual/kernel = "linux-redrouter"
PREFERRED_VERSION_linux-stable ?= "5.4%"
PREFERRED_PROVIDER_virtual/grub-bootconf = "btrup-bootconf"

INITRAMFS_IMAGE_BUNDLE = "1"
INITRAMFS_IMAGE = "redrouter-image-initramfs"

SDK_NAME = "${DISTRO}-${TCLIBC}-${SDKMACHINE}-${IMAGE_BASENAME}-${TUNE_PKGARCH}-${MACHINE}"
SDKPATH = "/opt/${DISTRO}/${SDK_VERSION}"

DISTRO_EXTRA_RDEPENDS += " ${REDROUTER_DEFAULT_EXTRA_RDEPENDS}"
DISTRO_EXTRA_RRECOMMENDS += " ${REDROUTER_DEFAULT_EXTRA_RRECOMMENDS}"

REDROUTERQEMUDEPS = "${@bb.utils.contains("INCOMPATIBLE_LICENSE", "GPL-3.0", "", "packagegroup-core-device-devel",d)}"
DISTRO_EXTRA_RDEPENDS_append_qemuarm = " ${REDROUTERQEMUDEPS}"
DISTRO_EXTRA_RDEPENDS_append_qemuarm64 = " ${REDROUTERQEMUDEPS}"
DISTRO_EXTRA_RDEPENDS_append_qemumips = " ${REDROUTERQEMUDEPS}"
DISTRO_EXTRA_RDEPENDS_append_qemuppc = " ${REDROUTERQEMUDEPS}"
DISTRO_EXTRA_RDEPENDS_append_qemux86 = " ${REDROUTERQEMUDEPS}"
DISTRO_EXTRA_RDEPENDS_append_qemux86-64 = " ${REDROUTERQEMUDEPS}"

GLIBC_GENERATE_LOCALES = "en_US.UTF-8"

TCLIBCAPPEND = ""

PREMIRRORS ??= "\
bzr://.*/.*   http://downloads.yoctoproject.org/mirror/sources/ \n \
cvs://.*/.*   http://downloads.yoctoproject.org/mirror/sources/ \n \
git://.*/.*   http://downloads.yoctoproject.org/mirror/sources/ \n \
gitsm://.*/.* http://downloads.yoctoproject.org/mirror/sources/ \n \
hg://.*/.*    http://downloads.yoctoproject.org/mirror/sources/ \n \
osc://.*/.*   http://downloads.yoctoproject.org/mirror/sources/ \n \
p4://.*/.*    http://downloads.yoctoproject.org/mirror/sources/ \n \
svn://.*/.*   http://downloads.yoctoproject.org/mirror/sources/ \n"

SANITY_TESTED_DISTROS ?= " \
            poky-2.7 \n \
            poky-3.0 \n \
            poky-3.1 \n \
            ubuntu-16.04 \n \
            ubuntu-18.04 \n \
            ubuntu-19.04 \n \
            ubuntu-20.04 \n \
            fedora-30 \n \
            fedora-31 \n \
            fedora-32 \n \
            centos-7 \n \
            centos-8 \n \
            debian-8 \n \
            debian-9 \n \
            debian-10 \n \
            opensuseleap-15.1 \n \
            "
#
# OELAYOUT_ABI allows us to notify users when the format of TMPDIR changes in
# an incompatible way. Such changes should usually be detailed in the commit
# that breaks the format and have been previously discussed on the mailing list
# with general agreement from the core team.
#
OELAYOUT_ABI = "12"

# add poky sanity bbclass
INHERIT += "poky-sanity"

# QA check settings - a little stricter than the OE-Core defaults
WARN_TO_ERROR_QA = "already-stripped compile-host-path install-host-path \
                    installed-vs-shipped ldflags pn-overrides rpaths staticdev \
                    unknown-configure-option useless-rpaths"
WARN_QA_remove = "${WARN_TO_ERROR_QA}"
ERROR_QA_append = " ${WARN_TO_ERROR_QA}"

require conf/distro/include/poky-world-exclude.inc
require conf/distro/include/no-static-libs.inc
require conf/distro/include/yocto-uninative.inc
require conf/distro/include/security_flags.inc
INHERIT += "uninative"

INHERIT += "reproducible_build"

BB_SIGNATURE_HANDLER ?= "OEEquivHash"
BB_HASHSERVE ??= "auto"
```

## conf/layer.conf
```bitbake
# We have a conf and classes directory, add to BBPATH
BBPATH .= ":${LAYERDIR}"

# We have recipes-* directories, add to BBFILES
BBFILES += "${LAYERDIR}/recipes-*/*/*.bb \
            ${LAYERDIR}/recipes-*/*/*.bbappend"

BBFILE_COLLECTIONS += "meta-redrouter"
BBFILE_PATTERN_meta-redrouter = "^${LAYERDIR}/"
BBFILE_PRIORITY_meta-redrouter = "6"

LAYERDEPENDS_meta-redrouter = "core"
LAYERSERIES_COMPAT_meta-redrouter = "dunfell"
```

## conf/machine/apu2.conf
```bitbake
#@TYPE: Machine
#@NAME: PC Engines apu2 x86_64
#@DESCRIPTION: Machine configuration for PC Engines apu2 platform.

DEFAULTTUNE ?= "btver2-64"
require conf/machine/include/tune-btver2.inc

include conf/machine/include/x86-base.inc
require conf/machine/include/qemuboot-x86.inc

MACHINE_FEATURES += "wifi pcbios"

# QEMU doesn't like the btver2 GCC architecture. Disable use of QEMU usermode.
MACHINE_FEATURES_BACKFILL_CONSIDERED = "qemu-usermode"

PREFERRED_PROVIDER_virtual/kernel ?= "linux-redrouter"
PREFERRED_PROVIDER_virtual/xserver ?= "xserver-xorg"
XSERVER ?= ""

MACHINE_EXTRA_RRECOMMENDS += " \
    kernel-modules \
    linux-firmware-ath10k \
"

GLIBC_ADDONS = "nptl"

SERIAL_CONSOLES = "115200;ttyS0"
#SERIAL_CONSOLES_CHECK = "ttyS0"
#For runqemu
QB_SYSTEM_NAME = "qemu-system-x86_64"

WKS_FILE ?= "redrouter.wks"
```

## conf/machine/include/tune-btver2.inc
```bitbake
# Settings for the GCC(1) cpu-type "btver2":
#
#     AMD Famil 16h CPU with 64-bit extensions, MOVBE, F16C, BMI, AVX, PCLMUL,
#     CX16, ABM, AES, MMX, SSE, SSE2, SSE3, SSSE3, SSE4a, SSE4.1, SSE4.2, and
#     POPCNT instruction set support.
#
# This tune is recommended for AMD Family 16h CPUs (and beyond).
#
DEFAULTTUNE ?= "btver2-64"

# Include the previous tune to pull in PACKAGE_EXTRA_ARCHS
require conf/machine/include/tune-core2.inc

# Extra tune features
TUNEVALID[btver2] = "Enable AMD Family 16h specific processor optimizations"
TUNE_CCARGS .= "${@bb.utils.contains('TUNE_FEATURES', 'btver2', ' -march=btver2', '', d)}"

# Extra tune selections
AVAILTUNES += "btver2-64"
TUNE_FEATURES_tune-btver2-64 = "${TUNE_FEATURES_tune-x86-64} btver2"
BASE_LIB_tune-btver2-64 = "lib64"
TUNE_PKGARCH_tune-btver2-64 = "btver2-64"
PACKAGE_EXTRA_ARCHS_tune-btver2-64 = "${PACKAGE_EXTRA_ARCHS_tune-core2-64} btver2-64"
QEMU_EXTRAOPTIONS_btver2-64 = " -cpu EPYC,check=false"
```

## conf/machine/include/tune-red.inc
```bitbake
# Settings for the GCC(1) cpu-type "nehalem":
#
#     Intel Nehalem CPU with 64-bit extensions, MMX, SSE, SSE2, SSE3, SSSE3, SSE4.1,
#     SSE4.2 and POPCNT instruction set support.
#
# This tune is recommended for Intel Nehalem and Silvermont (e.g. Bay Trail) CPUs
# (and beyond).
#

# Settings for redrectangle platforms. Supported CPUs are:
# AMD GX-412TC: Jaguar microarchitecture, AMD Family 16h cores. GCC CPU type
# btver2
#
# Extension	GX-412TC
# MMX		X
# SSE		X
# SSE2		X
# SSE3		X
# SSSE3		X
# SSE4a		X
# SSE4.1	X
# SSE4.2	X
# AVX		X
# AES		X
# PCLMUL	X
# F16C		X
# ABM		X
# BMI		X
#
# CX16		X
# MOVBE		X

DEFAULTTUNE ?= "red-64"

# Include the previous tune to pull in PACKAGE_EXTRA_ARCHS
require conf/machine/include/tune-core2.inc

# Extra tune features
TUNEVALID[red] = "Enable redrouter specific processor optimizations"
#TUNE_CCARGS .= "${@bb.utils.contains('TUNE_FEATURES', 'red', ' -march=x86-64 -mtune=generic -mfpmath=sse -mmmx -msse -msse2 -msse3 -mssse3 -msse4a -msse4.1 -msse4.2 -mavx -maes -mpclmul -mf16c -mabm -mbmi -mcx16 -mmovbe', '', d)}"
#TUNE_CCARGS .= "${@bb.utils.contains('TUNE_FEATURES', 'red', ' -march=x86-64 -mtune=generic -mfpmath=sse -mmmx -msse -msse2 -msse3 -mssse3 -msse4a -msse4.1 -msse4.2 -maes -mpclmul -mabm -mbmi -mcx16 -mmovbe', '', d)}"
TUNE_CCARGS .= "${@bb.utils.contains('TUNE_FEATURES', 'red', ' -march=x86-64 -mtune=generic -mfpmath=sse -mmmx -msse -msse2', '', d)}"

# Extra tune selections
AVAILTUNES += "red-64"
TUNE_FEATURES_tune-red-64 = "${TUNE_FEATURES_tune-x86-64} red"
BASE_LIB_tune-red-64 = "lib64"
TUNE_PKGARCH_tune-red-64 = "red-64"
PACKAGE_EXTRA_ARCHS_tune-red-64 = "${PACKAGE_EXTRA_ARCHS_tune-core2-64} red-64"
QEMU_EXTRAOPTIONS_red-64 = " -cpu SandyBridge,check=false"
```

## conf/machine/redrouterx86-64.conf
```bitbake
#@TYPE: Machine
#@NAME: Generic x86_64
#@DESCRIPTION: Machine configuration for generic x86_64 (64-bit) PCs and servers. Supports a moderately wide range of drivers that should boot and be usable on "typical" hardware.

DEFAULTTUNE ?= "red-64"
require conf/machine/include/tune-red.inc

include conf/machine/include/x86-base.inc
require conf/machine/include/qemuboot-x86.inc
MACHINE_FEATURES += "wifi efi pcbios"

PREFERRED_PROVIDER_virtual/kernel ?= "linux-redrouter"
PREFERRED_PROVIDER_virtual/xserver ?= "xserver-xorg"
XSERVER ?= ""

# linux-firmware"
MACHINE_EXTRA_RRECOMMENDS += " \
    kernel-modules \
    linux-firmware-ath10k \
"

GLIBC_ADDONS = "nptl"


IMAGE_FSTYPES += "wic wic.bmap"
WKS_FILE ?= "redrouter.wks"
EFI_PROVIDER ??= "grub-efi"

SERIAL_CONSOLES = "115200;ttyS0"
#SERIAL_CONSOLES_CHECK = "ttyS0"
#For runqemu
QB_SYSTEM_NAME = "qemu-system-x86_64"
```

## wic/redrouter.wks
```
# short-description: Create an EFI disk image
# long-description: Creates a partitioned EFI disk image that the user
# can directly dd to boot media.

#part /boot --source bootimg-efi --sourceparams="loader=grub-efi" --ondisk sda --label msdos --active --align 1024
#part /boot --source bootimg-biosplusefi --sourceparams="loader=grub-efi" --ondisk sda --label BOUTER-BOOT --active --align 1024 --use-uuid
part /boot --source bootimg-biosplusefi --sourceparams="loader=grub-efi" --label REDROUTER-BOOT --active --align 1024 --use-uuid

part / --source rootfs --ondisk sda --fstype=btrfs --label redrouter-root --align 1024 --use-uuid --fsoptions="compress=zstd"
#part / --source copy --sourceparams="file=bouter-image-rectanglex86-64.squashfs-lz4" --fstype=btrfs --label bouter-root --align 1024 --use-uuid --fsoptions="compress=zstd"
#part / --source copy --sourceparams="file=bouter-image-rectanglex86-64.squashfs-lz4" --fstype=ext4 --label bouter-root --align 1024 --use-uuid

#part /mnt/config --fstype=btrfs --label bouter-config --align 1024 --use-uuid --fixed-size=128 --fsoptions="compress=zstd"

bootloader --ptable gpt --timeout=5 --append="rootwait rootfstype=btrfs console=ttyS0,115200 console=tty0"
```
